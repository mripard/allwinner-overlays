/*
 * Copyright 2016 Free Electrons
 * Copyright 2016 NextThing Co
 *
 * Maxime Ripard <maxime.ripard@free-electrons.com>
 *
 * This file is dual-licensed: you can use it either under the terms
 * of the GPL or the X11 license, at your option. Note that this dual
 * licensing only applies to this file, and not this project as a
 * whole.
 *
 *  a) This file is free software; you can redistribute it and/or
 *     modify it under the terms of the GNU General Public License as
 *     published by the Free Software Foundation; either version 2 of the
 *     License, or (at your option) any later version.
 *
 *     This file is distributed in the hope that it will be useful,
 *     but WITHOUT ANY WARRANTY; without even the implied warranty of
 *     MERCHANTABILITY or FITNESS FOR A PARTICULAR PURPOSE.  See the
 *     GNU General Public License for more details.
 *
 * Or, alternatively,
 *
 *  b) Permission is hereby granted, free of charge, to any person
 *     obtaining a copy of this software and associated documentation
 *     files (the "Software"), to deal in the Software without
 *     restriction, including without limitation the rights to use,
 *     copy, modify, merge, publish, distribute, sublicense, and/or
 *     sell copies of the Software, and to permit persons to whom the
 *     Software is furnished to do so, subject to the following
 *     conditions:
 *
 *     The above copyright notice and this permission notice shall be
 *     included in all copies or substantial portions of the Software.
 *
 *     THE SOFTWARE IS PROVIDED "AS IS", WITHOUT WARRANTY OF ANY KIND,
 *     EXPRESS OR IMPLIED, INCLUDING BUT NOT LIMITED TO THE WARRANTIES
 *     OF MERCHANTABILITY, FITNESS FOR A PARTICULAR PURPOSE AND
 *     NONINFRINGEMENT. IN NO EVENT SHALL THE AUTHORS OR COPYRIGHT
 *     HOLDERS BE LIABLE FOR ANY CLAIM, DAMAGES OR OTHER LIABILITY,
 *     WHETHER IN AN ACTION OF CONTRACT, TORT OR OTHERWISE, ARISING
 *     FROM, OUT OF OR IN CONNECTION WITH THE SOFTWARE OR THE USE OR
 *     OTHER DEALINGS IN THE SOFTWARE.
 */
/dts-v1/;
/plugin/;

#include <dt-bindings/gpio/gpio.h>
#include <dt-bindings/input/input.h>
#include <dt-bindings/interrupt-controller/irq.h>

#include <dt-bindings/pinctrl/sun4i-a10.h>

#include <nextthingco/dip-pocket-common.dtsi>

&keyboard {
	linux,keymap = <
			MATRIX_KEY(0, 1, KEY_1)
			MATRIX_KEY(0, 2, KEY_2)
			MATRIX_KEY(0, 3, KEY_3)
			MATRIX_KEY(0, 4, KEY_4)
			MATRIX_KEY(0, 5, KEY_5)
			MATRIX_KEY(0, 6, KEY_6)
			MATRIX_KEY(0, 7, KEY_7)
			MATRIX_KEY(0, 8, KEY_8)
			MATRIX_KEY(0, 9, KEY_9)

			MATRIX_KEY(1, 0, KEY_Q)
			MATRIX_KEY(1, 1, KEY_W)
			MATRIX_KEY(1, 2, KEY_E)
			MATRIX_KEY(1, 3, KEY_R)
			MATRIX_KEY(1, 4, KEY_T)
			MATRIX_KEY(1, 5, KEY_Y)
			MATRIX_KEY(1, 6, KEY_U)
			MATRIX_KEY(1, 7, KEY_I)
			MATRIX_KEY(1, 8, KEY_O)
			MATRIX_KEY(1, 9, KEY_P)

			MATRIX_KEY(2, 0, KEY_A)
			MATRIX_KEY(2, 1, KEY_S)
			MATRIX_KEY(2, 2, KEY_D)
			MATRIX_KEY(2, 3, KEY_F)
			MATRIX_KEY(2, 4, KEY_G)
			MATRIX_KEY(2, 5, KEY_H)
			MATRIX_KEY(2, 6, KEY_J)
			MATRIX_KEY(2, 7, KEY_K)
			MATRIX_KEY(2, 8, KEY_L)
			MATRIX_KEY(2, 9, KEY_ENTER)

			MATRIX_KEY(3, 0, KEY_TAB)
			MATRIX_KEY(3, 1, KEY_Z)
			MATRIX_KEY(3, 2, KEY_X)
			MATRIX_KEY(3, 3, KEY_C)
			MATRIX_KEY(3, 4, KEY_V)
			MATRIX_KEY(3, 5, KEY_B)
			MATRIX_KEY(3, 6, KEY_N)
			MATRIX_KEY(3, 7, KEY_M)
			MATRIX_KEY(3, 8, KEY_UP)
			MATRIX_KEY(3, 9, KEY_DOWN)

			MATRIX_KEY(4, 0, KEY_LEFTSHIFT)
			MATRIX_KEY(4, 1, KEY_RIGHTALT)
			MATRIX_KEY(4, 2, KEY_LEFTALT)
			MATRIX_KEY(4, 3, KEY_SPACE)
			MATRIX_KEY(4, 4, KEY_RIGHTCTRL)
			MATRIX_KEY(4, 5, KEY_SLASH)
			MATRIX_KEY(4, 6, KEY_RIGHTSHIFT)
			MATRIX_KEY(4, 8, KEY_LEFT)
			MATRIX_KEY(4, 9, KEY_RIGHT)

			MATRIX_KEY(5, 0, KEY_ESC)
			MATRIX_KEY(5, 1, KEY_0)
			MATRIX_KEY(5, 2, KEY_EQUAL)
			MATRIX_KEY(5, 3, KEY_BACKSPACE)
			MATRIX_KEY(5, 4, KEY_DOT)
			>;
};
